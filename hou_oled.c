/*******************************************************************************
    Freescale MK60DN512xxx110 库函数 版本V1.0
编译环境：C/C++
主频：150MHz
时间：2015/10/31
地点：61#6003

*******************************************************************************/
#include "K60_datatype.h"





#define XLevelL		0x00
#define XLevelH		0x10
#define XLevel		((XLevelH&0x0F)*16+XLevelL)
#define Max_Column	128
#define Max_Row		  64
#define	Brightness	0xCF 
#define X_WIDTH         128
#define Y_WIDTH         64
//======================================
const byte F6x8[][6] =
{
    { 0x00, 0x00, 0x00, 0x00, 0x00, 0x00 },   // sp
    { 0x00, 0x00, 0x00, 0x2f, 0x00, 0x00 },   // !
    { 0x00, 0x00, 0x07, 0x00, 0x07, 0x00 },   // "
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    { 0x14, 0x14, 0x14, 0x14, 0x14, 0x14 }    // horiz lines
};
void LCD_WrDat(byte data)
{
	byte i=8;
        LCD_DC_HIGH;;;;    //LCD_DC=1;;
        asm("nop"); 
        LCD_SCL_LOW;;;;    //LCD_SCL=0;;
        asm("nop");    
  while(i--)
  {
       if(data&0x80)
       {
        LCD_SDA_HIGH;;;;  //LCD_SDA=1
       }
       else
       {
        LCD_SDA_LOW;;;;  //LCD_SDA=0
       }
       LCD_SCL_HIGH;     //LCD_SCL=1;;
       asm("nop");;;;
       LCD_SCL_LOW;;;;;   //LCD_SCL=0;;   
       data<<=1;    
  }
	
}
void LCD_WrCmd(byte cmd)
{
     byte i=8;
     LCD_DC_LOW;;;;; //LCD_DC=0;;
     LCD_SCL_LOW;;;;;//LCD_SCL=0;; 
    
  while(i--)
  {
	
    if(cmd&0x80)
    {
      LCD_SDA_HIGH;;;;;//LCD_SDA=1
    }
    else
    {
      LCD_SDA_LOW;;;;;;//LCD_SDA=0
    }
      LCD_SCL_HIGH;;;;;//LCD_SCL=1;; 
    asm("nop");;;;
		           
      LCD_SCL_LOW;;;;; //LCD_SCL=0;;    
      cmd<<=1;;;;;   
  } 	
	//LCD_CS=1;
}
void LCD_Set_Pos(byte x, byte y)
{ 
  LCD_WrCmd(0xb0+y);
  LCD_WrCmd(((x&0xf0)>>4)|0x10);
  LCD_WrCmd((x&0x0f)|0x00); 
} 
void LCD_Fill(byte bmp_data)
{
	byte y,x;
	
	for(y=0;y<8;y++)
	{
		LCD_WrCmd(0xb0+y);
		LCD_WrCmd(0x01);
		LCD_WrCmd(0x10);
		for(x=0;x<X_WIDTH;x++)
			LCD_WrDat(bmp_data);
	}
}
void LCD_CLS(void)
{
	byte y,x;	
	for(y=0;y<8;y++)
	{
		LCD_WrCmd(0xb0+y);
		LCD_WrCmd(0x01);
		LCD_WrCmd(0x10); 
		for(x=0;x<X_WIDTH;x++)
			LCD_WrDat(0);
	}
}
void LCD_DLY_ms(word ms)
{                         
  word a;
  while(ms)
  {
    a=13350;
    while(a--);
    ms--;
  }
  return;
}


void oledInit()
  {
      //设置GPIOD pin14,pin15为GPIO口 
	
//      PORTC_PCR19=(0|PORT_PCR_MUX(1));//LCD_DC
//	
//      PORTC_PCR17=(0|PORT_PCR_MUX(1)); //LCD_SCL
//	
//      PORTC_PCR16=(0|PORT_PCR_MUX(1));//LCD_SDA
//	
//      PORTC_PCR18=(0|PORT_PCR_MUX(1));//LCD_RST 
//	
//      //设置GPIOD pin14,pin15为输出方向
//      GPIOC_PDDR=GPIO_PDDR_PDD(GPIO_PIN(16)|GPIO_PIN(17)|GPIO_PIN(18)|GPIO_PIN(19));	
      LCD_SCL_HIGH;//LCD_SCL
      LCD_RST_LOW;//LCD_RST 
      LCD_DLY_ms(50);
      LCD_RST_HIGH;//LCD_RST 
      LCD_WrCmd(0xae);//--turn off oled panel
      LCD_WrCmd(0x00);//---set low column address
      LCD_WrCmd(0x10);//---set high column address
      LCD_WrCmd(0x40);//--set start line address  Set Mapping RAM Display Start Line (0x00~0x3F)
      LCD_WrCmd(0x81);//--set contrast control register
      LCD_WrCmd(0xcf); // Set SEG Output Current Brightness
      LCD_WrCmd(0xa1);//--Set SEG/Column Mapping     0xa0左右反置 0xa1正常
      LCD_WrCmd(0xc8);//Set COM/Row Scan Direction   0xc0上下反置 0xc8正常
      LCD_WrCmd(0xa6);//--set normal display
      LCD_WrCmd(0xa8);//--set multiplex ratio(1 to 64)
      LCD_WrCmd(0x3f);//--1/64 duty
      LCD_WrCmd(0xd3);//-set display offset	Shift Mapping RAM Counter (0x00~0x3F)
      LCD_WrCmd(0x00);//-not offset
      LCD_WrCmd(0xd5);//--set display clock divide ratio/oscillator frequency
      LCD_WrCmd(0x80);//--set divide ratio, Set Clock as 100 Frames/Sec
      LCD_WrCmd(0xd9);//--set pre-charge period
      LCD_WrCmd(0xf1);//Set Pre-Charge as 15 Clocks & Discharge as 1 Clock
      LCD_WrCmd(0xda);//--set com pins hardware configuration
      LCD_WrCmd(0x12);
      LCD_WrCmd(0xdb);//--set vcomh
      LCD_WrCmd(0x40);//Set VCOM Deselect Level
      LCD_WrCmd(0x20);//-Set Page Addressing Mode (0x00/0x01/0x02)
      LCD_WrCmd(0x02);//
      LCD_WrCmd(0x8d);//--set Charge Pump enable/disable
      LCD_WrCmd(0x14);//--set(0x10) disable
      LCD_WrCmd(0xa4);// Disable Entire Display On (0xa4/0xa5)
      LCD_WrCmd(0xa6);// Disable Inverse Display On (0xa6/a7) 
      LCD_WrCmd(0xaf);//--turn on oled panel
      LCD_Fill(0x00);  //初始清屏
      LCD_Set_Pos(0,0);  
  }
//==============================================================
//函数名： void LCD_PutPixel(byte x,byte y)
//功能描述：绘制一个点（x,y）
//参数：真实坐标值(x,y),x的范围0～127，y的范围0～64
//返回：无
//==============================================================
void LCD_PutPixel(byte x,byte y)
{
	byte data1;  //data1当前点的数据 
	 
  LCD_Set_Pos(x,y); 
	data1 = 0x01<<(y%8); 	
	LCD_WrCmd(0xb0+(y>>3));
	LCD_WrCmd(((x&0xf0)>>4)|0x10);
	LCD_WrCmd((x&0x0f)|0x00);
	LCD_WrDat(data1); 	 	
}
//==============================================================
//函数名：LCD_P6x8Str(byte x,byte y,byte *p)
//功能描述：写入一组标准ASCII字符串
//参数：显示的位置（x,y），y为页范围0～7，要显示的字符串
//返回：无
//==============================================================  
void LCD_P6x8Str(byte x,byte y,byte ch[])
{
  byte c=0,i=0,j=0;      
  while (ch[j]!='\0')
  {    
    c =ch[j]-32;
    if(x>126){x=0;y++;}
    LCD_Set_Pos(x,y);    
  	for(i=0;i<6;i++)     
  	  LCD_WrDat(F6x8[c][i]);  
  	x+=6;
  	j++;
  }
}
/*****************************************************************************
 函 数 名  : LED_PrintImage
 功能描述  : 将图像显示出来
 输入参数  : UCHAR8 *pucTable     二维图像数组的地址
             USHORT16 usRowNum    二维图像的行数1~64
             USHORT16 usColumnNum 二维图像的列数1~128
 输出参数  : none
 返 回 值  : none
*****************************************************************************/

void LED_PrintImage(unsigned char *pucTable, unsigned short int usRowNum, unsigned short int usColumnNum)
{
    unsigned char ucData;
    unsigned short int i,j,k,m,n;
    unsigned short int usRowTmp;

    m = usRowNum >> 3;   //计算图片行数以8位为一组完整的组数
    n = usRowNum % 8;    //计算分完组后剩下的行数
    
    for(i = 0; i < m; i++) //完整组行扫描
    {
        LCD_Set_Pos(0,(unsigned char)i);
        usRowTmp = i << 3;    //计算当前所在行的下标                  
        for(j = 0; j < usColumnNum; j++) //列扫描        
        {
            ucData = 0;
            for(k = 0; k < 8; k++) //在i组中对这8行扫描
            {
                ucData = ucData >> 1;
                if((pucTable + (usRowTmp + k) * usColumnNum)[j] ==1)
                {
                    ucData = ucData | 0x80;
                }
                
            }
            LCD_WrDat(ucData);
        }
    }
    
    LCD_Set_Pos(0,(unsigned char)i); //设置剩下的行显示的起始坐标
    usRowTmp = i << 3;       //计算当前所在行的下标                  
    for(j = 0; j < usColumnNum; j++) //列扫描        
    {
        ucData = 0;
        for(k = 0; k < n; k++) //对剩下的行扫描
        {
            ucData = ucData >> 1;
            if((pucTable + (usRowTmp + k) * usColumnNum)[j] ==1)
            {
                ucData = ucData | 0x80;
            }
            
        }
        ucData = ucData >> (8 - n);
        LCD_WrDat(ucData);
    }

    return;
}
